## drivers/input/touchscreen/Kconfig.rej
```kconfig
--- drivers/input/touchscreen/Kconfig
+++ drivers/input/touchscreen/Kconfig
@@ -996,7 +996,21 @@
 	depends on I2C
 	help
 	  This enables support for Synaptics RMI4 over I2C based touchscreens.
-
+	  
+config TOUCHSCREEN_SYNAPTICS_SWEEP2WAKE
+        tristate "Sweep2Wake for SYNAPTICS_3k based touchscreens"
+        default y
+          
+config TOUCHSCREEN_SYNAPTICS_SWEEP2WAKE_START
+	depends on TOUCHSCREEN_SYNAPTICS_SWEEP2WAKE
+	string "Sweep2Wake start button name"
+	default "BACK"
+
+config TOUCHSCREEN_SYNAPTICS_SWEEP2WAKE_END
+	depends on TOUCHSCREEN_SYNAPTICS_SWEEP2WAKE
+	string "Sweep2Wake end button name"
+	default "MENU"
+	
 config TOUCHSCREEN_MAX11871
         tristate "Maxim max11871 touchscreen"
         depends on I2C
```
